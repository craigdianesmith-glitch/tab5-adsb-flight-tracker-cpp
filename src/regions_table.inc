// Generated by tools/gen_regions.py from Natural Earth's 1:10m map units - do not edit.
// Latitude and longitude, a point at a time, ring after ring.
const float REGION_POINTS[] = {
    55.8055f, -2.0229f, 55.6499f, -2.2428f, 55.6382f, -2.3280f, 55.4490f, -2.1887f, 55.3625f, -2.3595f, 55.3633f, -2.4519f, 55.3144f, -2.5515f, 55.1672f, -2.7189f,
    55.1352f, -2.8225f, 55.0410f, -2.9538f, 55.0507f, -3.0261f, 54.9815f, -3.0503f, 54.9954f, -3.5705f, 54.8836f, -3.5817f, 54.8552f, -3.8124f, 54.8862f, -3.8170f,
    54.8445f, -3.8579f, 54.8247f, -3.8238f, 54.7682f, -4.0117f, 54.7825f, -4.0558f, 54.8315f, -4.0640f, 54.7769f, -4.0839f, 54.7730f, -4.1230f, 54.8262f, -4.2091f,
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    37.2904f, -75.8740f, 37.2056f, -75.8771f, 37.2002f, -75.8108f, 37.1292f, -75.9038f,
};
// Each ring: its first point, how many, and the box round it.
const RegionRing REGION_RINGS[] = {
    {0, 360, 54.6330f, -6.2345f, 58.6771f, -1.7593f},
    {360, 12, 55.4398f, -5.3929f, 55.7228f, -5.0708f},
    {372, 7, 55.7233f, -5.1995f, 55.9111f, -5.0218f},
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    {4583, 5, 37.1292f, -75.9038f, 37.2904f, -75.8108f},
};
// The airports in each, by code, in order.
const AirportRegion AIRPORT_REGIONS[] = {
    {"ABE", Region::USA}, {"ABI", Region::USA}, {"ABL", Region::USA}, {"ABQ", Region::USA}, {"ABR", Region::USA}, {"ABY", Region::USA},
    {"ABZ", Region::SCOTLAND}, {"ACK", Region::USA}, {"ACT", Region::USA}, {"ACV", Region::USA}, {"ACY", Region::USA}, {"ADK", Region::USA},
    {"ADQ", Region::USA}, {"AEX", Region::USA}, {"AGS", Region::USA}, {"AIA", Region::USA}, {"AIN", Region::USA}, {"AKN", Region::USA},
    {"AKP", Region::USA}, {"ALB", Region::USA}, {"ALO", Region::USA}, {"ALS", Region::USA}, {"ALW", Region::USA}, {"AMA", Region::USA},
    {"ANC", Region::USA}, {"ANI", Region::USA}, {"ANV", Region::USA}, {"AOO", Region::USA}, {"APN", Region::USA}, {"ARC", Region::USA},
    {"ART", Region::USA}, {"ASE", Region::USA}, {"ATK", Region::USA}, {"ATL", Region::USA}, {"ATW", Region::USA}, {"ATY", Region::USA},
    {"AUG", Region::USA}, {"AUS", Region::USA}, {"AVL", Region::USA}, {"AVP", Region::USA}, {"AZA", Region::USA}, {"AZO", Region::USA},
    {"BDL", Region::USA}, {"BEB", Region::SCOTLAND}, {"BED", Region::USA}, {"BET", Region::USA}, {"BFD", Region::USA}, {"BFF", Region::USA},
    {"BFI", Region::USA}, {"BFL", Region::USA}, {"BGM", Region::USA}, {"BGR", Region::USA}, {"BHB", Region::USA}, {"BHM", Region::USA},
    {"BHX", Region::ENGLAND}, {"BIH", Region::USA}, {"BIL", Region::USA}, {"BIS", Region::USA}, {"BJC", Region::USA}, {"BKG", Region::USA},
    {"BKW", Region::USA}, {"BLD", Region::USA}, {"BLI", Region::USA}, {"BLV", Region::USA}, {"BMI", Region::USA}, {"BNA", Region::USA},
    {"BOH", Region::ENGLAND}, {"BOI", Region::USA}, {"BOS", Region::USA}, {"BPT", Region::USA}, {"BQK", Region::USA}, {"BRD", Region::USA},
    {"BRL", Region::USA}, {"BRO", Region::USA}, {"BRR", Region::SCOTLAND}, {"BRS", Region::ENGLAND}, {"BRW", Region::USA}, {"BTI", Region::USA},
    {"BTM", Region::USA}, {"BTR", Region::USA}, {"BTV", Region::USA}, {"BUF", Region::USA}, {"BUR", Region::USA}, {"BWI", Region::USA},
    {"BZN", Region::USA}, {"CAE", Region::USA}, {"CAK", Region::USA}, {"CAL", Region::SCOTLAND}, {"CCR", Region::USA}, {"CDB", Region::USA},
    {"CDC", Region::USA}, {"CDR", Region::USA}, {"CDV", Region::USA}, {"CEC", Region::USA}, {"CEZ", Region::USA}, {"CGI", Region::USA},
    {"CHA", Region::USA}, {"CHO", Region::USA}, {"CHS", Region::USA}, {"CID", Region::USA}, {"CIU", Region::USA}, {"CKB", Region::USA},
    {"CLD", Region::USA}, {"CLE", Region::USA}, {"CLL", Region::USA}, {"CLT", Region::USA}, {"CMH", Region::USA}, {"CMI", Region::USA},
    {"CMX", Region::USA}, {"CNM", Region::USA}, {"CNY", Region::USA}, {"COD", Region::USA}, {"COS", Region::USA}, {"COU", Region::USA},
    {"CPR", Region::USA}, {"CRP", Region::USA}, {"CRW", Region::USA}, {"CSG", Region::USA}, {"CVG", Region::USA}, {"CVN", Region::USA},
    {"CWA", Region::USA}, {"CYS", Region::USA}, {"DAB", Region::USA}, {"DAL", Region::USA}, {"DAY", Region::USA}, {"DBQ", Region::USA},
    {"DCA", Region::USA}, {"DDC", Region::USA}, {"DEC", Region::USA}, {"DEN", Region::USA}, {"DFW", Region::USA}, {"DHN", Region::USA},
    {"DIK", Region::USA}, {"DJT", Region::USA}, {"DLG", Region::USA}, {"DLH", Region::USA}, {"DND", Region::SCOTLAND}, {"DOV", Region::USA},
    {"DRG", Region::USA}, {"DRO", Region::USA}, {"DSI", Region::USA}, {"DSM", Region::USA}, {"DTW", Region::USA}, {"DUJ", Region::USA},
    {"DUT", Region::USA}, {"DVL", Region::USA}, {"EAR", Region::USA}, {"EAT", Region::USA}, {"EAU", Region::USA}, {"ECP", Region::USA},
    {"EDI", Region::SCOTLAND}, {"EGE", Region::USA}, {"EGX", Region::USA}, {"EKO", Region::USA}, {"ELD", Region::USA}, {"ELM", Region::USA},
    {"ELP", Region::USA}, {"EMA", Region::ENGLAND}, {"EMK", Region::USA}, {"ENA", Region::USA}, {"EOI", Region::SCOTLAND}, {"ERI", Region::USA},
    {"ESC", Region::USA}, {"ESD", Region::USA}, {"EUG", Region::USA}, {"EVV", Region::USA}, {"EWB", Region::USA}, {"EWN", Region::USA},
    {"EWR", Region::USA}, {"EXT", Region::ENGLAND}, {"EYW", Region::USA}, {"FAI", Region::USA}, {"FAR", Region::USA}, {"FAT", Region::USA},
    {"FAY", Region::USA}, {"FCA", Region::USA}, {"FLG", Region::USA}, {"FLL", Region::USA}, {"FLO", Region::USA}, {"FNT", Region::USA},
    {"FOD", Region::USA}, {"FRD", Region::USA}, {"FSD", Region::USA}, {"FSM", Region::USA}, {"FTW", Region::USA}, {"FWA", Region::USA},
    {"FYU", Region::USA}, {"GAL", Region::USA}, {"GAM", Region::USA}, {"GCC", Region::USA}, {"GCK", Region::USA}, {"GCN", Region::USA},
    {"GDV", Region::USA}, {"GEG", Region::USA}, {"GFK", Region::USA}, {"GGG", Region::USA}, {"GGW", Region::USA}, {"GJT", Region::USA},
    {"GKN", Region::USA}, {"GLA", Region::SCOTLAND}, {"GLH", Region::USA}, {"GNV", Region::USA}, {"GPT", Region::USA}, {"GRB", Region::USA},
    {"GRI", Region::USA}, {"GRK", Region::USA}, {"GRR", Region::USA}, {"GSO", Region::USA}, {"GSP", Region::USA}, {"GST", Region::USA},
    {"GTF", Region::USA}, {"GTR", Region::USA}, {"GUC", Region::USA}, {"GUP", Region::USA}, {"GYY", Region::USA}, {"HCR", Region::USA},
    {"HDN", Region::USA}, {"HGR", Region::USA}, {"HHH", Region::USA}, {"HHR", Region::USA}, {"HIB", Region::USA}, {"HII", Region::USA},
    {"HLN", Region::USA}, {"HNL", Region::USA}, {"HNM", Region::USA}, {"HNS", Region::USA}, {"HOB", Region::USA}, {"HOM", Region::USA},
    {"HOT", Region::USA}, {"HOU", Region::USA}, {"HPN", Region::USA}, {"HRL", Region::USA}, {"HRO", Region::USA}, {"HSL", Region::USA},
    {"HSV", Region::USA}, {"HTS", Region::USA}, {"HUY", Region::ENGLAND}, {"HVN", Region::USA}, {"HVR", Region::USA}, {"HYA", Region::USA},
    {"HYS", Region::USA}, {"IAD", Region::USA}, {"IAG", Region::USA}, {"IAH", Region::USA}, {"IAN", Region::USA}, {"ICT", Region::USA},
    {"IDA", Region::USA}, {"ILG", Region::USA}, {"ILI", Region::USA}, {"ILM", Region::USA}, {"ILY", Region::SCOTLAND}, {"IMT", Region::USA},
    {"IND", Region::USA}, {"INL", Region::USA}, {"INV", Region::SCOTLAND}, {"IPL", Region::USA}, {"IPT", Region::USA}, {"IRK", Region::USA},
    {"ISP", Region::USA}, {"ITH", Region::USA}, {"ITO", Region::USA}, {"JAC", Region::USA}, {"JAN", Region::USA}, {"JAX", Region::USA},
    {"JBR", Region::USA}, {"JFK", Region::USA}, {"JHM", Region::USA}, {"JLN", Region::USA}, {"JMS", Region::USA}, {"JNU", Region::USA},
    {"JST", Region::USA}, {"KLW", Region::USA}, {"KOA", Region::USA}, {"KOI", Region::SCOTLAND}, {"KTN", Region::USA}, {"LAF", Region::USA},
    {"LAL", Region::USA}, {"LAN", Region::USA}, {"LAR", Region::USA}, {"LAS", Region::USA}, {"LAW", Region::USA}, {"LAX", Region::USA},
    {"LBA", Region::ENGLAND}, {"LBB", Region::USA}, {"LBE", Region::USA}, {"LBF", Region::USA}, {"LBL", Region::USA}, {"LCH", Region::USA},
    {"LCK", Region::USA}, {"LCY", Region::ENGLAND}, {"LEB", Region::USA}, {"LEX", Region::USA}, {"LFT", Region::USA}, {"LGA", Region::USA},
    {"LGB", Region::USA}, {"LGW", Region::ENGLAND}, {"LHR", Region::ENGLAND}, {"LIH", Region::USA}, {"LIT", Region::USA}, {"LNK", Region::USA},
    {"LNS", Region::USA}, {"LNY", Region::USA}, {"LPL", Region::ENGLAND}, {"LRD", Region::USA}, {"LRU", Region::USA}, {"LSE", Region::USA},
    {"LSI", Region::SCOTLAND}, {"LTN", Region::ENGLAND}, {"LUK", Region::USA}, {"LUR", Region::USA}, {"LWB", Region::USA}, {"LWS", Region::USA},
    {"LYH", Region::USA}, {"MAF", Region::USA}, {"MAN", Region::ENGLAND}, {"MBS", Region::USA}, {"MCE", Region::USA}, {"MCG", Region::USA},
    {"MCI", Region::USA}, {"MCK", Region::USA}, {"MCN", Region::USA}, {"MCO", Region::USA}, {"MCW", Region::USA}, {"MDT", Region::USA},
    {"MDW", Region::USA}, {"MEI", Region::USA}, {"MEM", Region::USA}, {"MFE", Region::USA}, {"MFR", Region::USA}, {"MGC", Region::USA},
    {"MGM", Region::USA}, {"MGW", Region::USA}, {"MHK", Region::USA}, {"MHT", Region::USA}, {"MIA", Region::USA}, {"MKE", Region::USA},
    {"MKG", Region::USA}, {"MKK", Region::USA}, {"MKL", Region::USA}, {"MLB", Region::USA}, {"MLI", Region::USA}, {"MLU", Region::USA},
    {"MME", Region::ENGLAND}, {"MMH", Region::USA}, {"MOB", Region::USA}, {"MOT", Region::USA}, {"MQT", Region::USA}, {"MRI", Region::USA},
    {"MRY", Region::USA}, {"MSL", Region::USA}, {"MSN", Region::USA}, {"MSO", Region::USA}, {"MSP", Region::USA}, {"MSS", Region::USA},
    {"MSY", Region::USA}, {"MTJ", Region::USA}, {"MUE", Region::USA}, {"MWA", Region::USA}, {"MWL", Region::USA}, {"MYL", Region::USA},
    {"MYR", Region::USA}, {"MYU", Region::USA}, {"NCL", Region::ENGLAND}, {"NPT", Region::USA}, {"NQY", Region::ENGLAND}, {"NUI", Region::USA},
    {"NWI", Region::ENGLAND}, {"OAJ", Region::USA}, {"OAK", Region::USA}, {"OCE", Region::USA}, {"OGD", Region::USA}, {"OGG", Region::USA},
    {"OGS", Region::USA}, {"OKC", Region::USA}, {"OLF", Region::USA}, {"OLM", Region::USA}, {"OMA", Region::USA}, {"OME", Region::USA},
    {"ONT", Region::USA}, {"OPF", Region::USA}, {"ORD", Region::USA}, {"ORF", Region::USA}, {"ORH", Region::USA}, {"ORT", Region::USA},
    {"OTH", Region::USA}, {"OTZ", Region::USA}, {"OWB", Region::USA}, {"PAE", Region::USA}, {"PAH", Region::USA}, {"PBG", Region::USA},
    {"PDK", Region::USA}, {"PDT", Region::USA}, {"PDX", Region::USA}, {"PGA", Region::USA}, {"PGD", Region::USA}, {"PGV", Region::USA},
    {"PHF", Region::USA}, {"PHL", Region::USA}, {"PHX", Region::USA}, {"PIA", Region::USA}, {"PIB", Region::USA}, {"PIE", Region::USA},
    {"PIH", Region::USA}, {"PIK", Region::SCOTLAND}, {"PIR", Region::USA}, {"PIT", Region::USA}, {"PIZ", Region::USA}, {"PKB", Region::USA},
    {"PLN", Region::USA}, {"PNS", Region::USA}, {"PQI", Region::USA}, {"PRC", Region::USA}, {"PSC", Region::USA}, {"PSG", Region::USA},
    {"PSM", Region::USA}, {"PSP", Region::USA}, {"PTH", Region::USA}, {"PTU", Region::USA}, {"PUB", Region::USA}, {"PUW", Region::USA},
    {"PVD", Region::USA}, {"PVU", Region::USA}, {"PWM", Region::USA}, {"RAP", Region::USA}, {"RBY", Region::USA}, {"RDD", Region::USA},
    {"RDM", Region::USA}, {"RDU", Region::USA}, {"RFD", Region::USA}, {"RHI", Region::USA}, {"RIC", Region::USA}, {"RIW", Region::USA},
    {"RKD", Region::USA}, {"RKS", Region::USA}, {"RNO", Region::USA}, {"ROA", Region::USA}, {"ROC", Region::USA}, {"ROW", Region::USA},
    {"RST", Region::USA}, {"RSW", Region::USA}, {"RUT", Region::USA}, {"SAF", Region::USA}, {"SAN", Region::USA}, {"SAT", Region::USA},
    {"SAV", Region::USA}, {"SBA", Region::USA}, {"SBD", Region::USA}, {"SBN", Region::USA}, {"SBP", Region::USA}, {"SBY", Region::USA},
    {"SCC", Region::USA}, {"SCE", Region::USA}, {"SCK", Region::USA}, {"SDF", Region::USA}, {"SDP", Region::USA}, {"SDY", Region::USA},
    {"SEA", Region::USA}, {"SEN", Region::ENGLAND}, {"SFB", Region::USA}, {"SFO", Region::USA}, {"SGF", Region::USA}, {"SGU", Region::USA},
    {"SHD", Region::USA}, {"SHR", Region::USA}, {"SHV", Region::USA}, {"SIT", Region::USA}, {"SJC", Region::USA}, {"SJT", Region::USA},
    {"SLC", Region::USA}, {"SLE", Region::USA}, {"SLK", Region::USA}, {"SLN", Region::USA}, {"SMF", Region::USA}, {"SMN", Region::USA},
    {"SMX", Region::USA}, {"SNA", Region::USA}, {"SNP", Region::USA}, {"SOU", Region::ENGLAND}, {"SOW", Region::USA}, {"SPI", Region::USA},
    {"SPS", Region::USA}, {"SQL", Region::USA}, {"SRQ", Region::USA}, {"STC", Region::USA}, {"STG", Region::USA}, {"STL", Region::USA},
    {"STN", Region::ENGLAND}, {"STS", Region::USA}, {"SUN", Region::USA}, {"SUX", Region::USA}, {"SVA", Region::USA}, {"SVC", Region::USA},
    {"SWF", Region::USA}, {"SWO", Region::USA}, {"SYR", Region::USA}, {"SYY", Region::SCOTLAND}, {"TBN", Region::USA}, {"TEB", Region::USA},
    {"TEX", Region::USA}, {"TIW", Region::USA}, {"TKF", Region::USA}, {"TLH", Region::USA}, {"TOL", Region::USA}, {"TPA", Region::USA},
    {"TRE", Region::SCOTLAND}, {"TRI", Region::USA}, {"TSM", Region::USA}, {"TTN", Region::USA}, {"TUL", Region::USA}, {"TUP", Region::USA},
    {"TUS", Region::USA}, {"TVC", Region::USA}, {"TVF", Region::USA}, {"TWF", Region::USA}, {"TXK", Region::USA}, {"TYR", Region::USA},
    {"TYS", Region::USA}, {"UIN", Region::USA}, {"UNK", Region::USA}, {"USA", Region::USA}, {"UST", Region::USA}, {"UTO", Region::USA},
    {"VCT", Region::USA}, {"VDZ", Region::USA}, {"VEL", Region::USA}, {"VLD", Region::USA}, {"VPS", Region::USA}, {"VRB", Region::USA},
    {"WIC", Region::SCOTLAND}, {"WKK", Region::USA}, {"WRG", Region::USA}, {"WST", Region::USA}, {"WYS", Region::USA}, {"XNA", Region::USA},
    {"XWA", Region::USA}, {"YAK", Region::USA}, {"YKM", Region::USA}, {"YUM", Region::USA},
};
// Each place: its rings, the first of them and how many.
const RegionShape REGION_SHAPES[] = {
    {Region::SCOTLAND, 0, 43},
    {Region::ENGLAND, 43, 4},
    {Region::USA, 47, 155},
};
